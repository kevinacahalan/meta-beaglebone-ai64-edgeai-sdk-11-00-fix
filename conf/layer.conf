## conf/layer.conf
```bitbake
# Layer configuration for meta-beaglebone-ai64-edgeai-sdk-11-00-fix
# Local customizations / fixes for the BeagleBone AI-64 on TISDK 11.00 (edgeai).

BBPATH .= ":${LAYERDIR}"
BBFILES += "${LAYERDIR}/recipes-*/*/*.bb ${LAYERDIR}/recipes-*/*/*.bbappend"

BBFILE_COLLECTIONS += "meta-beaglebone-ai64-edgeai-sdk-11-00-fix"
BBFILE_PATTERN_meta-beaglebone-ai64-edgeai-sdk-11-00-fix := "^${LAYERDIR}/"
# High priority so our .bbappends / files win over the base layers.
BBFILE_PRIORITY_meta-beaglebone-ai64-edgeai-sdk-11-00-fix = "999"

LAYERDEPENDS_meta-beaglebone-ai64-edgeai-sdk-11-00-fix = "core meta-edgeai"
LAYERSERIES_COMPAT_meta-beaglebone-ai64-edgeai-sdk-11-00-fix = "scarthgap"
```
